// SPDX-License-Identifier: BSD-3-Clause
/*
 * HP OmniBook 5 16-bf1xxx, minimal device tree: CPUs, storage, input, lid,
 * Wi-Fi and Bluetooth, on the firmware framebuffer. No display, GPU,
 * remoteproc or PMIC GLink nodes. This is the fallback when the full
 * device tree does not come up.
 */
/dts-v1/;

#include "glymur-hp-omnibook-5-bf1xxx.dtsi"

/ {
	model = "HP OmniBook 5 Laptop 16-bf1xxx (minimal)";
	compatible = "hp,omnibook-5-16-bf1xxx", "qcom,glymur";
};

&tlmm {
	/*
	 * Allow-list: everything except the pins this file uses is reserved.
	 * Used: 0-1 i2c0, 3 touchpad, 16-17 i2c4, 32-33 i2c8, 51 touchscreen,
	 * 56-59 uart14, 67 keyboard, 92 lid, 116 BT enable, 146-148 PCIe 4,
	 * 152-154 PCIe 5.
	 */
	gpio-reserved-ranges = <2 1>, <4 12>, <18 14>, <34 17>, <52 4>,
			       <60 7>, <68 24>, <93 23>, <117 29>,
			       <149 3>, <155 95>;
};
