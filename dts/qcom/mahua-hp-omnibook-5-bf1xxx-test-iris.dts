// SPDX-License-Identifier: BSD-3-Clause
/*
 * HP OmniBook 5 16-bf1xxx, test device tree with the Iris video codec on,
 * for one boot of the Mahua video trials (kernel -19,
 * docs/video-iris-windows-2026-11-06.md). Chosen at the GRUB menu in place
 * of the test device tree; check-video.sh --mahua sets the trial
 * parameters. Iris keeps Glymur's description (both vcodec domains); the
 * trials power only vcodec 0 (video_cc_mvs0_gdsc), as Windows does here.
 */
/dts-v1/;

#include "mahua-hp-omnibook-5-bf1xxx-test.dts"

/ {
	model = "HP OmniBook 5 Laptop 16-bf1xxx (test, Iris)";
};

&iris {
	status = "okay";
};
